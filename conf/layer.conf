## conf/layer.conf
```bitbake
# We have a conf and classes directory, prepend to BBPATH
# This must be prepended to allow our classes to load before OE's
BBPATH =. "${LAYERDIR}:"

# We have recipes-* directories, add to BBFILES
#BBFILES += "${LAYERDIR}/recipes-*/*/*.bb ${LAYERDIR}/recipes-*/*/*.bbappend"

BBFILE_COLLECTIONS += "wr-template"
BBFILE_PATTERN_wr-template = ""
BBFILE_PRIORITY_wr-template = "1"

# This should only be incremented on significant changes that will
# cause compatibility issues with other layers
LAYERVERSION_wr-template = "1"

LAYERDEPENDS_wr-template = "core"

USER_CLASSES_append = " wrlbanner wrltemplate"
```

## tests/layer2/conf/layer.conf
```bitbake
# We have a conf and classes directory, add to BBPATH
BBPATH .= ":${LAYERDIR}"

BBFILE_COLLECTIONS += "wr-template-tests-layer2"
BBFILE_PATTERN_wr-template-tests-layer2 = ""

# This should only be incremented on significant changes that will
# cause compatibility issues with other layers
LAYERVERSION_wr-template-tests-layer2 = "1"

LAYERDEPENDS_wr-template-tests-layer2 = "wr-template-tests-layer1"
```
